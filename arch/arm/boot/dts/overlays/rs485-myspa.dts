/dts-v1/;
/plugin/;

/ {
    fragment@0 {
        target = <&uart4>;
        __overlay__ {
            linux,rs485-enabled-at-boot-time;
        };
    };

    fragment@1 {
        target = <&uart3>;
        __overlay__ { 
            linux,rs485-enabled-at-boot-time; 
        };
    };
};
